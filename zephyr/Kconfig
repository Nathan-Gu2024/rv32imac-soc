## zephyr/boards/others/rv32_5stage/board.yml
```yaml
board:
  name: rv32_5stage
  full_name: RV32IMC 5-Stage Pipelined RISC-V (Zynq-7020 FPGA soft-core)
  vendor: others
  socs:
    - name: rv32_5stage
```

## zephyr/drivers/cache/Kconfig
```kconfig
# Custom RV32IMC 5-stage pipelined RISC-V CPU (Zynq-7020 FPGA soft-core)
# Cache maintenance by set displacement (src/dcache_bram.v).
# SPDX-License-Identifier: Apache-2.0

config CACHE_RV32_5STAGE
	bool "RV32 5-stage set-displacement cache maintenance"
	default y
	depends on EXTERNAL_CACHE
	help
	  Implements Zephyr's external cache interface for a SoC that has no
	  cache-maintenance instructions at all - no cbo.*, no fence.i, no
	  maintenance CSR and no uncached DRAM window.

	  The D-cache is direct-mapped and write-back, so touching an address
	  that maps to the same set as a target line displaces it and the
	  existing writeback path pushes it to DRAM. That is the only
	  mechanism available, and it is what makes the GEMM accelerator's DMA
	  coherent with CPU-visible memory.

	  Note that invalidate cannot be separated from flush here: a
	  displacement always writes a dirty line back. See the comment at the
	  top of cache_rv32_5stage.c for the call ordering that makes DMA
	  destinations safe.

if CACHE_RV32_5STAGE

config CACHE_RV32_5STAGE_DCACHE_BYTES
	int "Total D-cache size in bytes"
	default 16384
	help
	  DC_NUM_SETS * 16 from src/cpu.v: 16384 for the FPGA build (1024
	  sets, the default) and 8192 for the ASIC build, which sets
	  DC_NUM_SETS=512 via SYNTH_PARAMETERS.

	  This value is the address offset that maps to the same cache set, so
	  the displacement walk depends on it exactly. Getting it wrong is not
	  symmetric:

	    too LARGE  - still correct, as long as it is a MULTIPLE of the real
	                 size. 16384 works on an 8 KB cache because 16384 =
	                 2 * 8192, so the alias still lands in the same set.
	    too SMALL  - silently broken. The alias lands in a different set,
	                 displaces nothing, and the DMA reads stale data with
	                 no error anywhere.

	  So when in doubt round UP to the largest geometry the RTL is ever
	  built with. The default is deliberately the FPGA size for that
	  reason - it is also valid for the ASIC build.

endif # CACHE_RV32_5STAGE
```

## zephyr/drivers/interrupt_controller/Kconfig
```kconfig
# Custom RV32IMC 5-stage pipelined RISC-V CPU (Zynq-7020 FPGA soft-core)
# Second-level interrupt aggregator (src/intc.v).
# SPDX-License-Identifier: Apache-2.0

menuconfig INTC_RV32_5STAGE
	bool "RV32 5-stage custom interrupt controller"
	default y
	depends on DT_HAS_RV32_5STAGE_INTC_ENABLED
	depends on MULTI_LEVEL_INTERRUPTS
	select 2ND_LEVEL_INTERRUPTS
	help
	  Second-level interrupt aggregator for src/intc.v: one shared
	  enable mask and one shared, edge-latched, write-1-to-clear
	  pending register, feeding the CPU's own riscv,cpu-intc external
	  interrupt line (mip.MEIP, IRQ 11). Not a PLIC - no priorities,
	  no claim/complete.

if INTC_RV32_5STAGE

config INTC_RV32_5STAGE_INIT_PRIORITY
	int "Init priority"
	default 0
	help
	  Must initialize (and enable its own level-1 IRQ) before any
	  device behind it - e.g. the UART in interrupt-driven mode -
	  tries to enable its own line.

endif # INTC_RV32_5STAGE
```

## zephyr/drivers/misc/Kconfig
```kconfig
# Custom RV32IMC 5-stage pipelined RISC-V CPU (Zynq-7020 FPGA soft-core)
# INT8 systolic GEMM accelerator (src/mm_accel.v).
# SPDX-License-Identifier: Apache-2.0

config GEMM_RV32_5STAGE
	bool "RV32 5-stage INT8 GEMM accelerator"
	default y
	depends on DT_HAS_RV32_5STAGE_GEMM_ENABLED
	select CACHE_MANAGEMENT
	help
	  Driver for the Chisel-generated systolic-array GEMM accelerator.
	  Submits descriptor batches, blocks on a semaphore released by the
	  batch-completion interrupt rather than spinning on STATUS, and
	  serialises threads with a mutex.

	  CACHE_MANAGEMENT is required, not optional: the accelerator's DMA
	  moves operands and results over mem_arbiter's third port, behind the
	  write-back D-cache, so the driver must flush operands before a batch
	  and displace destinations after it. Without a working cache backend
	  the results a thread reads back are whatever the cache happened to
	  hold.

config GEMM_RV32_5STAGE_INIT_PRIORITY
	int "Init priority"
	default 60
	depends on GEMM_RV32_5STAGE
	help
	  Must be after the interrupt controller, since init calls
	  irq_enable_next_level() on it.
```

## zephyr/drivers/serial/Kconfig
```kconfig
# Custom RV32IMC 5-stage pipelined RISC-V CPU (Zynq-7020 FPGA soft-core)
# UART driver (src/uart_mmio.v).
# SPDX-License-Identifier: Apache-2.0

config UART_RV32_5STAGE
	bool "RV32 5-stage custom UART driver"
	default y
	depends on DT_HAS_RV32_5STAGE_UART_ENABLED
	select SERIAL_HAS_DRIVER
	select SERIAL_SUPPORT_INTERRUPT
	help
	  Driver for the custom uart_mmio.v peripheral: 4 word-aligned
	  registers (TX_DATA/TX_STATUS/RX_DATA/RX_STATUS) at fixed offsets,
	  no runtime baud-rate configuration (fixed in hardware at synthesis
	  time via uart_tx.v/uart_rx.v parameters). Polling mode always
	  works; select CONFIG_UART_INTERRUPT_DRIVEN separately to also
	  build the interrupt-driven path, which needs
	  rv32_5stage,intc (drivers/interrupt_controller) as its
	  interrupt-parent.
```

## zephyr/dts/bindings/gpio/rv32_5stage,led-gpio.yaml
```yaml
description: |
  LED_ADDR MMIO in cpu.v: a single 32-bit write-only register, low 4 bits
  drive 4 discrete LEDs directly (no per-bit direction/read-back - modeled
  as a 4-line output-only GPIO controller). No interrupt.

compatible: "rv32_5stage,led-gpio"

include: [gpio-controller.yaml, base.yaml]

properties:
  reg:
    required: true
```

## zephyr/dts/bindings/interrupt-controller/rv32_5stage,intc.yaml
```yaml
description: |
  Custom single-level external-interrupt aggregator (src/intc.v). NOT a
  PLIC - no priorities, no claim/complete. Just one shared ENABLE mask
  register and one shared, edge-latched, write-1-to-clear PENDING
  register, both 32 bits wide (though only the low NUM_SOURCES bits are
  meaningful). Forwards to the CPU's own riscv,cpu-intc external
  interrupt line (mip.MEIP/mie.MEIE, bit 11) via interrupts-extended.

compatible: "rv32_5stage,intc"

include: [interrupt-controller.yaml, base.yaml]

properties:
  reg:
    required: true

  "#interrupt-cells":
    const: 1

interrupt-cells:
  - irq
```

## zephyr/dts/bindings/misc/rv32_5stage,gemm.yaml
```yaml
description: |
  INT8 systolic-array GEMM accelerator (chisel/src/MmAccel.scala, emitted as
  src/mm_accel.v). A constant-size 23-word AXI4-Lite register window in a
  0x100-byte block; geometry (dim, maxK, bPanels) is fixed at Chisel
  elaboration and is read back from the INFO register at word 9, so software
  does not hardcode it.

  The window is control only. Operands and results move over mem_arbiter's
  third 128-bit port straight to DRAM, BEHIND the write-back D-cache, so a
  driver must flush before the accelerator reads operands and invalidate
  before the CPU reads results - see drivers/cache/cache_rv32_5stage.c.

  Two interrupt sources on the parent rv32_5stage,intc:

    batch  qDone   - a queued descriptor batch finished (CTRL bit5). Asserts
                     ONCE per batch regardless of how many tiles it held.
    dma    dmaDone - a result store finished. During a queued batch the
                     sequencer restarts the store per tile, so this asserts
                     once per TILE; leave it masked in queue mode.

  Both are sticky levels rather than pulses: the underlying DONE bit is
  cleared only by the next kick of that engine, which presents exactly one
  rising edge per completion to the edge-capturing aggregator.

compatible: "rv32_5stage,gemm"

include: [base.yaml]

properties:
  reg:
    required: true

  interrupts:
    required: true
```

## zephyr/dts/bindings/serial/rv32_5stage,uart.yaml
```yaml
description: |
  Custom UART (src/uart_mmio.v). 4 word-aligned registers in a single
  0x10-byte block, offsets fixed in hardware (not independently
  relocatable, so no reg-names): TX_DATA=0x0, TX_STATUS=0x4, RX_DATA=0x8,
  RX_STATUS=0xC. TX_STATUS bit 0 = tx_ready, RX_STATUS bit 0 = rx_has_data.
  Two interrupt sources on the parent rv32_5stage,intc: TX-complete
  (edge-detected tx_ready 0->1) and RX-data-available (rx_valid pulse).

compatible: "rv32_5stage,uart"

include: [uart-controller.yaml, base.yaml]

properties:
  reg:
    required: true

  interrupts:
    required: true
```

## zephyr/soc/others/rv32_5stage/Kconfig.soc
```kconfig
# Custom RV32IMC 5-stage pipelined RISC-V SoC (FPGA soft-core)
# SPDX-License-Identifier: Apache-2.0

config SOC_RV32_5STAGE
	bool
	help
	  Custom RV32IMC 5-stage pipelined RISC-V CPU, implemented as an FPGA
	  soft-core (Zynq-7020 PL fabric). Standard RISC-V privileged trap
	  model (mstatus/mie/mip/mtvec/mepc/mcause), a CLINT-compatible
	  mtime/mtimecmp timer, and a minimal single-line external-interrupt
	  aggregator (not a PLIC) feeding mip.MEIP.

config SOC
	default "rv32_5stage" if SOC_RV32_5STAGE
```
